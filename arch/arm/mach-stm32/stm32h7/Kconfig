## arch/arm/mach-stm32/stm32h7/Kconfig
```kconfig
if STM32H7

config TARGET_STM32H743_DISCO
	bool "STM32H743 Discovery board"

config TARGET_STM32H743_EVAL
	bool "STM32H743 Evaluation board"

config TARGET_STM32H745_DISCO
	bool "STM32H745 Discovery board"

source "board/st/stm32h743-eval/Kconfig"
source "board/st/stm32h743-disco/Kconfig"
source "board/st/stm32h745-disco/Kconfig"

endif
```

## board/st/stm32h745-disco/Kconfig
```kconfig
if TARGET_STM32H745_DISCO

config SYS_BOARD
	string
	default "stm32h745-disco"

config SYS_VENDOR
	string
	default "st"

config SYS_SOC
	string
	default "stm32h7"

config SYS_CONFIG_NAME
	string
	default "stm32h745-disco"

endif
```
